/**
 * Copyright (c) 2026 Gabriel Guerrer
 *
 * Distributed under the MIT license - See LICENSE for details
 */

#include <avr/interrupt.h>
#include <avr/wdt.h>
#include <math.h>
#include "rava8_timers.h"

volatile uint16_t timer3_overflow_n = 0;

/* ===========================
 * RAVA8 TIMERS
 * =========================== */

/*
Configures the internal PLL to generate a 48 MHz clock.

This configuration is required by peripherals such as Timer 4 and the USB subsystem.
*/
void pll_setup_48mhz(void)
{
  // Reset registers
  PLLCSR = 0;
  PLLFRQ = 0;

  // 16MHz clock
  #if F_CPU == 16000000UL
  PLLCSR |= _BV(PINDIV); //16 MHz clock source
  PLLFRQ |= _BV(PDIV3) | _BV(PDIV1);  // CLK_PLL 96MHz
  PLLFRQ |= _BV(PLLTM1) | _BV(PLLTM0); // PLLTM = CLK_PLL / 2
  PLLFRQ |= _BV(PLLUSB); // PLLUSB = CLK_PLL / 2

    // 8MHz clock
  #elif F_CPU == 8000000UL
  PLLFRQ |= _BV(PDIV2); // CLK_PLL 48MHz
  PLLFRQ |= _BV(PLLTM0); // PLLTM / 1
  #endif

  // Enable PLL
  PLLCSR |= _BV(PLLE);

  // Wait until PLL locks to the configured frequency
  while (!(PLLCSR & _BV(PLOCK))) {};
}

/*
Restores Timer 0 to its default inactive configuration.
*/
void timer0_reset(void)
{
  // Normal mode, TOP at 0xff
  TCCR0A = 0;

  // No clock source
  TCCR0B = 0;

  // Interrupts disabled
  TIMSK0 = 0;
}

/*
Configures Timer 0 to operate as a counter driven by external rising-edge pulses.

This mode is employed by the RNG module to count comparator pulses associated with randomness
channel "B".
*/
void timer0_setup_rng(void)
{
  // Reset
  timer0_reset();

  // External clock source on T0 pin
  TCCR0B = TIMER013_CLK_EXTERN_RISING_EDGE;
}

/*
Restores Timer 1 to its default inactive configuration.
*/
void timer1_reset(void)
{
  // Normal mode, TOP at 0xffff
  TCCR1A = 0;

  // No clock source
  TCCR1B = 0;
  TCCR1C = 0;

  // Interrupts disabled
  TIMSK1 = 0;
}

/*
Configures Timer 1 to operate as a counter driven by external rising-edge pulses.

This mode is employed by the RNG module to count comparator pulses associated with randomness
channel "A".
*/
void timer1_setup_rng(void)
{
  // Reset
  timer1_reset();

  // External clock source on T1 pin
  TCCR1B = TIMER013_CLK_EXTERN_RISING_EDGE;
}

/*
Restores Timer 3 to its default inactive configuration.
*/
void timer3_reset(void)
{
  // Normal mode, TOP at 0xffff
  TCCR3A = 0;

  // No clock source
  TCCR3B = 0;
  TCCR3C = 0;

  // Interrupts disabled
  TIMSK3 = 0;

  // PC6 as input
  DDRC &= ~_BV(6);
}

/*
Configures Timer 3 to operate as a chronometer.

The timer is configured to generate an overflow interrupt every second, triggering
`ISR(TIMER3_OVF_vect)` to extend the measurable interval beyond the 16-bit counter range. The
elapsed time can later be retrieved through `timer3_stop_chronometer()`.
*/
void timer3_start_chronometer(void)
{
  // Reset
  timer3_reset();

  // Setup prescaler
  TCCR3B = TIMER013_CLK_DIV_256;

  // Fast PWM, TOP at ICR3
  TCCR3A |= _BV(WGM31);
  TCCR3B |= _BV(WGM33) | _BV(WGM32);

  // Setup prescaler
  ICR3 = 62499; // overflow every 1s ; 62500 / (16MHz/256)

  // Clear any pending overflow flag
  TIFR3 |= _BV(TOV3);

  // Overflow Interrupt Enable
  TIMSK3 |= _BV(TOIE3);  // Triggering ISR(TIMER3_OVF_vect)

  // Restart counter
  timer3_overflow_n = 0;
  TCNT3 = 0;
}

/*
Stops the Timer 3 chronometer and returns the elapsed time, in milliseconds, since
`timer3_start_chronometer()` or `timer3_setup_input_capture_pc7()` was called.

The returned interval combines the current Timer 3 counter value with the accumulated overflow
count generated by `ISR(TIMER3_OVF_vect)`.
*/
float timer3_stop_chronometer(void)
{
  uint16_t timer3_count = TCNT3;
  float interval_ms = (float)timer3_count * 0.016 + (float)timer3_overflow_n*1000.;

  timer3_reset();

  return interval_ms;
}

/*
Configures the Timer 3 clock prescaler according to the requested interrupt interval and returns
the corresponding TOP value employed by `timer3_setup_interrupt()`.
*/
uint16_t timer3_setup_clock(uint16_t interval_ms)
{
  // Assumes a 16MHz external clock
  float ticks_per_ms;

  // Find the correct prescaler and the associated number of ticks per ms
  if (interval_ms <= 32) {  // 2**16/(16MHz/8)
    TCCR3B = TIMER013_CLK_DIV_8; // clk/8
    ticks_per_ms = 2000.;  // (16MHz/8)/1000
  }
  else if (interval_ms <= 262) {  // 2**16/(16MHz/64)
    TCCR3B = TIMER013_CLK_DIV_64; // clk/64
    ticks_per_ms = 250.;  // (16MHz/64)/1000
  }
  else if (interval_ms <= 1048) {  // 2**16/(16MHz/256)
    TCCR3B = TIMER013_CLK_DIV_256; // clk/256
    ticks_per_ms = 62.5;  // (16MHz/256)/1000
  }
  else if (interval_ms <= 4194) {  // 2**16/(16MHz/1024)
    TCCR3B = TIMER013_CLK_DIV_1024; // clk/1024
    ticks_per_ms = 15.625;  // (16MHz/1024)/1000
  }
  else {
    return 0;
  }

  // Return delay ticks, the quantity of clock ticks for interval_ms
  uint16_t delay_ticks = round((float)interval_ms * ticks_per_ms);
  delay_ticks -= 1;
  return delay_ticks;
}

/*
Configures Timer 3 to generate a periodic interrupt on ISR (TIMER3_COMPA_vect).

This functionality is employed by the peridic byte random byte strem feature, enabled through
rng_start_byte_stream().
*/
void timer3_setup_interrupt(uint16_t interval_ms, uint8_t interrupt_ch)
{
  if (interrupt_ch > 2) {
    return;
  }

  // Reset
  timer3_reset();

  // Setup clock
  OCR3A = timer3_setup_clock(interval_ms);

  // CTC mode, TOP at OCR3A
  TCCR3B |= _BV(WGM32);

  // Output Compare Match Interrupt Enable
  if (interrupt_ch == 0) {
    TIMSK3 |= _BV(OCIE3A);  // ISR(TIMER3_COMPA_vect)
  }
  else if (interrupt_ch == 1) {
    TIMSK3 |= _BV(OCIE3B);  // ISR(TIMER3_COMPB_vect)
  }
  else if (interrupt_ch == 2) {
    TIMSK3 |= _BV(OCIE3C);  // ISR(TIMER3_COMPC_vect)
  }

  // Restart counter
  TCNT3 = 0;
}

/*
Configures Timer 3 to generate constant-frequency PWM signals on pin PC6.

This functionality is employed by `d3_setup_timer3_pwm()` for PWM generation and by
`d3_setup_timer3_sound()` for sound synthesis.
*/
void timer3_setup_pwm_pc6(uint8_t freq_prescaler, uint16_t top, uint16_t duty)
{
  // Reset
  timer3_reset();

  // Frequency prescaler
  TCCR3B = freq_prescaler % 6;

  // Fast PWM, TOP at ICR3
  TCCR3A |= _BV(WGM31);
  TCCR3B |= _BV(WGM33) | _BV(WGM32);

  // Clear OC3A on compare match ; PWM output to port C6
  TCCR3A |= _BV(COM3A1);

  // Port C6: Output mode
  PORTC &= ~_BV(6);
  DDRC |= _BV(6);

  // Setup top and duty
  ICR3 = top;
  OCR3A = duty;

  // Restart counter
  TCNT3 = 0;
}

/*
Configures Timer 3 to generates a periodic pulse signal on PC6 with an approximately 100 µs HIGH
duration and the specified period in milliseconds.

Utilized by `d3_setup_timer3_trigger_output()`.
*/
void timer3_setup_trigger_output_pc6(uint16_t interval_ms)
{
  // Find 100us duty. Assumes a 16MHz external clock
  uint16_t duty_100us = 0;
  if (interval_ms <= 32) { // 2**16/(16MHz/8)
    duty_100us = 200;  // (16MHz/8)/1000 / 10
  }
  else if (interval_ms <= 262) {  // 2**16/(16MHz/64)
    duty_100us = 25;  // (16MHz/64)/1000 / 10
  }
  else if (interval_ms <= 1048) {  // 2**16/(16MHz/256)
    duty_100us = 6;  // (16MHz/256)/1000 / 10
  }
  else if (interval_ms <= 4194) {  // 2**16/(16MHz/1024)
    duty_100us = 2;  // (16MHz/1024)/1000 / 10
  }

  // Reset
  timer3_reset();

  // Setup prescaler (CS3i) and set the TOP value
  ICR3 = timer3_setup_clock(interval_ms);

  // Fast PWM, TOP at ICR3
  TCCR3A |= _BV(WGM31);
  TCCR3B |= _BV(WGM33) | _BV(WGM32);

  // Clear OC3A on compare match ; PWM output to port C6
  TCCR3A |= _BV(COM3A1);

  // Port C6: Output mode
  PORTC &= ~_BV(6);
  DDRC |= _BV(6);

  // Setup duty
  OCR3A = duty_100us;

  // Restart counter
  TCNT3 = 0;
}

/*
Configures Timer 3 to operate as a chronometer driven by rising-edge pulses detected on pin PC7
through the Input Capture unit.

The timer is configured to generate input-capture interrupts via `ISR(TIMER3_CAPT_vect)` whenever a
rising edge is detected. Overflow interrupts `ISR(TIMER3_OVF_vect)` are also enabled to extend the
measurement interval beyond the 16-bit timer range. An input noise canceler is enabled to improve
edge detection stability.

This functionality is employed by `d2_setup_timer3_input_capture_pc7()`.
*/
void timer3_setup_input_capture_pc7(void)
{
  // Reset
  timer3_reset();

  // Setup prescaler
  TCCR3B = TIMER013_CLK_DIV_256;

  // Fast PWM mode, TOP at OCR3A, OVERFLOW at TOP
  TCCR3A |= _BV(WGM31) | _BV(WGM30);
  TCCR3B |= _BV(WGM33) | _BV(WGM32);

  // Setup prescaler
  OCR3A = 62499; // overflow every 1s ; 62500 / (16MHz/256)

  // Enable Input Capture Noise Canceler
  TCCR3B |= _BV(ICNC3);

  // Input Capture Edge Select
  TCCR3B |= _BV(ICES3); // Rising edge

  // Clear any pending Input capture flag
  TIFR3 |= _BV(ICF3);

  // Input Capture Interrupt Enable
  TIMSK3 |= _BV(ICIE3);  // Triggering ISR(TIMER3_CAPT_vect)

  // Overflow Interrupt Enable
  TIMSK3 |= _BV(TOIE3);  // Triggering ISR(TIMER3_OVF_vect)

  // Restart counter
  TCNT3 = 0;
}

/*
Restores Timer 4 to its default inactive configuration.
*/
void timer4_reset(void)
{
  // Normal mode, TOP at OCR4C
  TCCR4A = 0;

  // No clock source
  TCCR4B = 0;
  TCCR4C = 0;
  TCCR4D = 0;
  TCCR4E = 0;

  // B6 as input
  DDRB &= ~_BV(6);

  // C6 as input
  DDRC &= ~_BV(6);
}

/*
Configures Timer 4 to generate the PWM signal, employed by the boost converter module through
output pin PB6.

This timer requires the PLL postscaler to be configured so that both `clk_USB` and `clk_TMR`
operate at 48 MHz. This is performed via `pll_setup_48mhz()` function.
*/
void timer4_setup_pwm_pb6(uint8_t freq_prescaler, uint8_t top, uint8_t duty)
{
  // Reset Timer4
  timer4_reset();

  // Prescaling factor
  TCCR4B = freq_prescaler % 16;

  // Fast PWM mode based on OCR4B, TOP at OCR4C
  TCCR4A |= _BV(PWM4B);

  // Clear OC4B on Compare Match
  TCCR4A |= _BV(COM4B1);

  // PWM output to port B6; Output mode
  PORTB &= ~_BV(6);
  DDRB |= _BV(6);

  // Define TOP value ; OC4B frequency of (48MHz / prescaling factor) / OCR4C
  OCR4C = top;

  // Set duty value
  OCR4B = duty;

  // Reset counter
  TCNT4 = 0;
}

/*
This function clears the Watchdog Reset Flag (WDRF) in the MCU status register, which indicates
whether the previous reset was caused by the watchdog timer. WDRF must be cleared before the WDT
configuration can be modified.
*/
void wdt_init(void)
{
  // Clear Watchdog Reset Flag
  // To clear WDE, WDRF must be cleared first
  MCUSR &= ~_BV(WDRF);
}

/*
Disables the watchdog timer and restores its default inactive configuration.
*/
void wdt_reset_(void)
{
  // Disable Interrupts
  cli();

  // Watchdog Change Enable
  WDTCSR = _BV(WDCE) | _BV(WDE);

  // Change register
  WDTCSR = 0;

  // Enable Interrupts
  sei();
}

/*
Configures the watchdog timer to operate in interrupt mode with timeout interval defined by
`freq_prescaler`.

Upon timeout, the watchdog triggers the `ISR (WDT_vect)` interrupt service routine.
*/
void wdt_setup_interrupt(uint8_t freq_prescaler)
{
  // Disable Interrupts
  cli();

  // Watchdog Change Enable
  WDTCSR = _BV(WDCE) | _BV(WDE);

  // Set timeout interval with WDIE enabled (see enum WDT_CLOCK)
  WDTCSR = _BV(WDIE) | freq_prescaler;

  // Enable Interrupts
  sei();
}

/*
Configures the watchdog timer to force a system reboot.

The watchdog timer is first reset and then configured in system reset mode (WDE enabled). Once the
configured timeout interval expires, the MCU is automatically restarted.
*/
void wdt_reboot_device(void)
{
  // Disable Interrupts
  cli();

  // Reset the WDT timer
  wdt_reset();

  // Watchdog Change Enable
  WDTCSR = _BV(WDCE) | _BV(WDE);

	// System Reset Enable
  WDTCSR = _BV(WDE);

  // Enable Interrupts
	sei();
}